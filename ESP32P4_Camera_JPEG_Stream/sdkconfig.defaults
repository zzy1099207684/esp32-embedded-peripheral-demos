## ESP32P4_Camera_JPEG_Stream/sdkconfig.defaults
```kconfig
# ESP32-P4 Camera Project Default Configuration

# WiFi Configuration
CONFIG_ESP_WIFI_ENABLED=y
CONFIG_ESP_WIFI_STATIC_RX_BUFFER_NUM=10
CONFIG_ESP_WIFI_DYNAMIC_RX_BUFFER_NUM=32
CONFIG_ESP_WIFI_STATIC_TX_BUFFER=y
CONFIG_ESP_WIFI_STATIC_TX_BUFFER_NUM=16
CONFIG_ESP_WIFI_RX_BA_WIN=6
CONFIG_ESP_WIFI_TX_BA_WIN=6
CONFIG_ESP_WIFI_AMPDU_RX_ENABLED=y
CONFIG_ESP_WIFI_AMPDU_TX_ENABLED=y
CONFIG_ESP_WIFI_AMSDU_TX_ENABLED=n
CONFIG_ESP_WIFI_NVS_ENABLED=y
CONFIG_ESP_WIFI_SOFTAP_BEACON_MAX_LEN=752
CONFIG_ESP_WIFI_MGMT_SBUF_NUM=32
CONFIG_ESP_WIFI_IRAM_OPT=y
CONFIG_ESP_WIFI_RX_IRAM_OPT=y
CONFIG_ESP_WIFI_ENABLE_WPA3_SAE=y
CONFIG_ESP_WIFI_ENABLE_WPA3_OWE_STA=y
CONFIG_ESP_WIFI_DYNAMIC_RX_MGMT_BUF=16
CONFIG_ESP_WIFI_ESPNOW_MAX_ENCRYPT_NUM=7

# LWIP Configuration
CONFIG_LWIP_LOCAL_HOSTNAME="esp32p4-camera"

# ESP NETIF Configuration
CONFIG_ESP_NETIF_TCPIP_LWIP=y

# FreeRTOS Configuration
CONFIG_FREERTOS_HZ=1000

CONFIG_IDF_EXPERIMENTAL_FEATURES=y
CONFIG_SPIRAM=y
CONFIG_SPIRAM_SPEED_200M=y


# ESP System Settings
CONFIG_ESP_TASK_WDT_EN=y
CONFIG_ESP_TASK_WDT_TIMEOUT_S=5
CONFIG_ESP_TASK_WDT_CHECK_IDLE_TASK_CPU0=y
CONFIG_ESP_TASK_WDT_CHECK_IDLE_TASK_CPU1=y

# HTTP Server
CONFIG_HTTPD_MAX_REQ_HDR_LEN=1024
CONFIG_HTTPD_MAX_URI_LEN=512

# Video Configuration
CONFIG_ESP_VIDEO_ENABLE_DVP_VIDEO_DEVICE=y

# Partition Table
CONFIG_PARTITION_TABLE_SINGLE_APP_LARGE=y

# Compiler Options
CONFIG_COMPILER_OPTIMIZATION_DEFAULT=y
```
